## base_external/package/aesd-assignments/Config.in
```kconfig
config BR2_PACKAGE_AESD_ASSIGNMENTS
	bool "aesd-assignments"
	help
	  Includes the aesdsocket server executable and aesdsocket-start-stop init script.
	  Used to understand buildroot external trees and package builds.
```

## base_external/package/ldd/Config.in
```kconfig
config BR2_PACKAGE_LDD
	bool "ldd"
        depends on BR2_LINUX_KERNEL
	help
	  Includes LDD kernel modules examples.
	  Used to understand buildroot external trees and kernel module package builds.
```
